## boards/shields/theduplex/Kconfig.defconfig
```kconfig
if SHIELD_THEDUPLEX_LEFT

# Name must be less than 16 characters long!
config ZMK_KEYBOARD_NAME
    default "The Duplex"

config ZMK_SPLIT_ROLE_CENTRAL
    default y

endif

if SHIELD_THEDUPLEX_LEFT || SHIELD_THEDUPLEX_RIGHT

config ZMK_SPLIT
    default y

endif
```

## config/shields/theduplex/Kconfig.defconfig
```kconfig
if SHIELD_theduplex_left

# Name must be less than 16 characters long!
config ZMK_KEYBOARD_NAME
    default "The Duplex"

config ZMK_SPLIT_ROLE_CENTRAL
    default y

endif

if SHIELD_theduplex_left || SHIELD_theduplex_right

config ZMK_SPLIT
    default y

endif
```
